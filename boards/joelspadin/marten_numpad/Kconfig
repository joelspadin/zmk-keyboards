## boards/joelspadin/marten_numpad/Kconfig
```kconfig
if BOARD_MARTEN_NUMPAD

config BOARD_POWER_BUTTON_SOFT_OFF
    bool "Power off the board when the power button is pressed"
    default y

endif
```

## boards/joelspadin/marten_numpad/Kconfig.defconfig
```kconfig
if BOARD_MARTEN_NUMPAD

config ZMK_KEYBOARD_NAME
    default "Marten Numpad"

if USB

config USB_NRFX
    default y

config USB_DEVICE_STACK
    default y

endif # USB

config BT_CTLR
    default BT

endif # BOARD_MARTEN_NUMPAD
```

## boards/joelspadin/marten_numpad/Kconfig.marten_numpad
```kconfig
config BOARD_MARTEN_NUMPAD
    select SOC_NRF52840_QIAA
    imply RETAINED_MEM
    imply RETENTION
    imply RETENTION_BOOT_MODE
```

## boards/joelspadin/marten_numpad/marten_numpad_defconfig
```kconfig
CONFIG_ARM_MPU=y
CONFIG_FPU=y

CONFIG_CHARGER=y
CONFIG_LED=y
CONFIG_FUEL_GAUGE=y
CONFIG_GPIO=y
CONFIG_PINCTRL=y
CONFIG_PWM=y
CONFIG_REGULATOR=y
CONFIG_SENSOR=y

# Place application at &code_partition address
CONFIG_USE_DT_CODE_PARTITION=y

# Generate a .uf2 firmware image
CONFIG_BUILD_OUTPUT_UF2=y

# Enable NVS for settings
CONFIG_MPU_ALLOW_FLASH_WRITE=y
CONFIG_NVS=y
CONFIG_SETTINGS_NVS=y
CONFIG_FLASH=y
CONFIG_FLASH_PAGE_LAYOUT=y
CONFIG_FLASH_MAP=y

# Using a 20ppm crystal
CONFIG_CLOCK_CONTROL_NRF_K32SRC_20PPM=y

# Get notified if we overflow a stack
CONFIG_HW_STACK_PROTECTION=y

# Enable ZMK features
CONFIG_ZMK_BLE=y
CONFIG_ZMK_USB=y
```

## boards/shields/marten_nice_view/Kconfig.shield
```kconfig
config SHIELD_MARTEN_NICE_VIEW
    def_bool $(shields_list_contains,marten_nice_view)
```

## boards/shields/marten_ssd1306/Kconfig.shield
```kconfig
config SHIELD_MARTEN_SSD1306
    def_bool $(shields_list_contains,marten_ssd1306)
```

## drivers/Kconfig
```kconfig
rsource "charger/Kconfig"
rsource "fuel_gauge/Kconfig"
rsource "indicators/Kconfig"
```

## drivers/charger/npm1300/Kconfig
```kconfig
config CHARGER_NPM1300_NEW_API
    bool "nPM1300 PMIC charger driver"
    default y
    depends on DT_HAS_NORDIC_NPM1300_CHARGER_NEW_API_ENABLED
    select MFD_NPM1300
    select NPM1300_CHARGER
```

## drivers/fuel_gauge/npm1300/Kconfig
```kconfig
config FUEL_GAUGE_NPM1300
    bool "nPM1300 PMIC fuel gauge driver"
    default y
    depends on DT_HAS_NORDIC_NPM1300_FUEL_GAUGE_ENABLED
    select MFD_NPM1300
    select NPM1300_CHARGER
```

## drivers/indicators/Kconfig
```kconfig
config ZMK_INDICATOR_LEDS
    bool
    default y
    depends on DT_HAS_ZMK_INDICATOR_LEDS_ENABLED
    select LED
    select ZMK_HID_INDICATORS
```

## dts/bindings/charger/nordic,npm1300-charger-new-api.yaml
```yaml
description: nPM1300 Charger (new API)

compatible: "nordic,npm1300-charger-new-api"

properties:
  charger:
    type: phandle
    required: true
    description: The nordic,npm1300-charger device.
```

## dts/bindings/fuel_gauge/nordic,npm1300-fuel-gauge.yaml
```yaml
description: nPM1300 Fuel Gauge

compatible: "nordic,npm1300-fuel-gauge"

include: [fuel-gauge.yaml]

properties:
  charger:
    type: phandle
    required: true
    description: The nordic,npm1300-charger device.
```
